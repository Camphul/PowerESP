## main/Kconfig.projbuild
```kconfig
menu "PowerESP Config"
	config I2C_CLK_FREQ
		int "I2C Clock Frequency"
		range 0 400000
		default 400000
		help
			The frequency used by the I2C clock.
	config I2C_SDA_PIN
		int "I2C SDA pin"
		range 0 36
		default 21
		help
			I2C SDA pin used by OLED and PWM controller.
	config I2C_SCL_PIN
		int "I2C SCL pin"
		range 0 36
		default 22
		help
			I2C SCL pin used by OLED and PWM controller.
	config GPIO_PIN_SOFTLATCH_POWER
		int "Softlatch power pin"
		range 0 36
		default 33
		help
			Pin used to output signal to the mosfet power bootstrap circuit.
	config GPIO_PIN_SOFTLATCH_BUTTON
		int "Softlatch button detect pin"
		range 0 36
		default 32
		help
			Pin from which can be sensed if the button connected to the bootstrap circuit is pressed.
	config LEDRING_R
		int "Red PWM channel on PCA9632"
		range 0 2
		default 0
		help
			PWM channel on the PCA0632 connected to the color red.
	config LEDRING_G
		int "Green PWM channel on PCA9632"
		range 0 2
		default 1
		help
			PWM channel on the PCA0632 connected to the color green.
	config LEDRING_B
		int "Blue PWM channel on PCA9632"
		range 0 2
		default 2
		help
			PWM channel on the PCA0632 connected to the color blue.
endmenu
```

## sdkconfig.defaults
```kconfig
#
# I2Cbus
#
CONFIG_I2CBUS_FREERTOS_TASK_MUTEX=y
CONFIG_I2CBUS_LOG_ERRORS=y
CONFIG_I2CBUS_LOG_READWRITES=y
CONFIG_I2CBUS_LOG_RW_LEVEL_INFO=y
CONFIG_I2CBUS_LOG_RW_LEVEL_DEBUG=
CONFIG_I2CBUS_LOG_RW_LEVEL_VERBOSE=
#
# main/Kconfig.projbuild
#
CONFIG_I2C_CLK_FREQ=400000
CONFIG_I2C_SDA_PIN=21
CONFIG_I2C_SCL_PIN=22
CONFIG_GPIO_PIN_SOFTLATCH_POWER=33
CONFIG_GPIO_PIN_SOFTLATCH_BUTTON=33
CONFIG_LEDRING_R=0
CONFIG_LEDRING_G=1
CONFIG_LEDRING_B=2
```
